## conf/layer.conf
```bitbake
# We have a conf and classes directory, add to BBPATH
BBPATH =. "${LAYERDIR}:"

# We have a packages directory, add to BBFILES
BBFILES += "${LAYERDIR}/recipes-*/*/*.bb"

BBFILE_COLLECTIONS += "meta-mediapipe-cmake"
BBFILE_PATTERN_meta-mediapipe-cmake = "^${LAYERDIR}/"
BBFILE_PRIORITY_meta-mediapipe-cmake = "10"

LAYERVERSION_meta-mediapipe-cmake = "1"

LAYERSERIES_COMPAT_meta-mediapipe-cmake = "scarthgap"

LAYERDEPENDS_meta-mediapipe-cmake = " \
    core \
    meta-python \
    openembedded-layer \
"

LAYER_PATH_meta-mediapipe-cmake = "${LAYERDIR}"
```
